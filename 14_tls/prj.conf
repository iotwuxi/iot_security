## prj.conf
```kconfig
# General config
CONFIG_NEWLIB_LIBC=y
CONFIG_STDOUT_CONSOLE=y
CONFIG_ENTROPY_GENERATOR=y

# Networking config
CONFIG_NETWORKING=y
CONFIG_NET_IPV4=y
CONFIG_NET_TCP=y
CONFIG_NET_UDP=y

# Socket config
CONFIG_NET_SOCKETS=y
CONFIG_NET_SOCKETS_POSIX_NAMES=y

# Network DNS config
CONFIG_DNS_RESOLVER=y
CONFIG_DNS_SERVER_IP_ADDRESSES=y
CONFIG_DNS_SERVER1="114.114.114.114"

# Network address config
CONFIG_NET_CONFIG_SETTINGS=y
CONFIG_NET_CONFIG_NEED_IPV4=y
CONFIG_NET_CONFIG_MY_IPV4_ADDR="192.0.2.1"
CONFIG_NET_CONFIG_MY_IPV4_GW="192.0.2.2"

# Mbedtls config
CONFIG_MBEDTLS=y
CONFIG_MBEDTLS_BUILTIN=y
CONFIG_MBEDTLS_ENABLE_HEAP=y
CONFIG_MBEDTLS_HEAP_SIZE=15360
CONFIG_MBEDTLS_CFG_FILE="mbedtls_config.h"

CONFIG_MAIN_STACK_SIZE=4096

# Native_Posix
CONFIG_NET_L2_ETHERNET=y
CONFIG_ETH_NATIVE_POSIX=y
CONFIG_ETH_NATIVE_POSIX_RANDOM_MAC=y
```

## prj_nucleo_f429zi.conf
```kconfig
# General config
CONFIG_NEWLIB_LIBC=y
CONFIG_STDOUT_CONSOLE=y
CONFIG_ENTROPY_GENERATOR=y

# Networking config
CONFIG_NETWORKING=y
CONFIG_NET_IPV4=y
CONFIG_NET_TCP=y
CONFIG_NET_UDP=y

# Socket config
CONFIG_NET_SOCKETS=y
CONFIG_NET_SOCKETS_POSIX_NAMES=y

# Network DNS config
CONFIG_DNS_RESOLVER=y
CONFIG_DNS_SERVER_IP_ADDRESSES=y
CONFIG_DNS_SERVER1="114.114.114.114"

# Network address config
CONFIG_NET_CONFIG_SETTINGS=y
CONFIG_NET_CONFIG_NEED_IPV4=y
CONFIG_NET_CONFIG_MY_IPV4_ADDR="192.168.1.18"
CONFIG_NET_CONFIG_MY_IPV4_GW="192.168.1.1"

# Mbedtls config
CONFIG_MBEDTLS=y
CONFIG_MBEDTLS_BUILTIN=y
CONFIG_MBEDTLS_ENABLE_HEAP=y
CONFIG_MBEDTLS_HEAP_SIZE=10240
CONFIG_MBEDTLS_CFG_FILE="mbedtls_config.h"

CONFIG_MAIN_STACK_SIZE=4096
```

## src/main.c
```c
#include <zephyr.h>

#include <stdio.h>
#include <string.h>
#include <errno.h>

#include "mbedtls/net.h"
#include "mbedtls/ssl.h"
#include "mbedtls/entropy.h"
#include "mbedtls/ctr_drbg.h"
#include "mbedtls/platform.h"

#include "ca_cert.h"

#if defined(MBEDTLS_DEBUG_C)
#include "mbedtls/debug.h"
#define DEBUG_THRESHOLD 4

static void my_debug(void *ctx, int level,
                     const char *file, int line, const char *str)
{
    const char *p, *basename;

    /* Extract basename from file */
    for (p = basename = file; *p != '\0'; p++)
    {
        if (*p == '/' || *p == '\\')
        {
            basename = p + 1;
        }
    }

    mbedtls_printf("%s:%04d: |%d| %s", basename, line, level, str);
}
#endif

#define assert_exit(cond, ret) \
    do { if (!(cond)) { \
        printf("  !. assert: failed [line: %d, error: -0x%04X]\n", __LINE__, -(ret)); \
        goto cleanup; \
    } } while (0)

#define SERVER_ADDR         "iotwuxi.org"
#define SERVER_PORT         "442"
#define HOSTNAME            "iotwuxi.org"
#define GET_REQUEST         "GET /index.html HTTP/1.0\r\n\r\n"

static int entropy_source(void *data, uint8_t *output, size_t len, size_t *olen)
{
    uint32_t seed;
    ARG_UNUSED(data);
    seed = sys_rand32_get();

    if (len > sizeof(seed)) {
        len = sizeof(seed);
    }

    memcpy(output, &seed, len);
    *olen = len;

    return 0;
}

int main(void)
{ 
    uint8_t buf[256];
    int ret = 0, len = 0;
    const char *pers = "tls_client";
    mbedtls_entropy_context entropy;
    mbedtls_ctr_drbg_context ctr_drbg;

    mbedtls_platform_set_printf(printf);
    mbedtls_platform_set_snprintf(snprintf);

    mbedtls_x509_crt ca;
    mbedtls_net_context ctx;
    mbedtls_ssl_context ssl;
    mbedtls_ssl_config conf;
    
    mbedtls_net_init(&ctx);
    mbedtls_ssl_init(&ssl);
    mbedtls_ssl_config_init(&conf);
    mbedtls_ctr_drbg_init(&ctr_drbg);
    mbedtls_x509_crt_init(&ca);

    mbedtls_printf("\n  tls client use %s board.\n", CONFIG_BOARD);
    mbedtls_printf("\n  . Seeding the random number generator ... ");
    mbedtls_entropy_init(&entropy);
    mbedtls_entropy_add_source(&entropy, entropy_source, NULL,
               MBEDTLS_ENTROPY_MAX_GATHER, MBEDTLS_ENTROPY_SOURCE_STRONG);

    ret = mbedtls_ctr_drbg_seed(&ctr_drbg, mbedtls_entropy_func, &entropy,
                                  (const uint8_t *)pers, strlen(pers));
    assert_exit(ret == 0, ret);

    mbedtls_printf(" ok\n  . Setting up the SSL/TLS structure ... ");
    ret = mbedtls_ssl_config_defaults(&conf, MBEDTLS_SSL_IS_CLIENT,
                        MBEDTLS_SSL_TRANSPORT_STREAM, MBEDTLS_SSL_PRESET_DEFAULT);
    assert_exit(ret == 0, ret);

    mbedtls_ssl_conf_rng(&conf, mbedtls_ctr_drbg_random, &ctr_drbg);
    ret = mbedtls_x509_crt_parse_der(&ca, ca_cert_der, ca_cert_der_len);
    assert_exit(ret == 0, ret);

    mbedtls_ssl_conf_ca_chain(&conf, &ca, NULL);
    mbedtls_ssl_conf_authmode(&conf, MBEDTLS_SSL_VERIFY_REQUIRED);

#if defined(MBEDTLS_DEBUG_C)
    mbedtls_debug_set_threshold(DEBUG_THRESHOLD);
    mbedtls_ssl_conf_dbg(&conf, my_debug, NULL);
#endif

    ret = mbedtls_ssl_setup(&ssl, &conf);
    assert_exit(ret == 0, ret);
    
    ret = mbedtls_ssl_set_hostname(&ssl, HOSTNAME);
    assert_exit(ret == 0, ret);

    mbedtls_printf(" ok\n  . Connecting to %s:%s...", SERVER_ADDR, SERVER_PORT);
    ret = mbedtls_net_connect( &ctx, SERVER_ADDR, SERVER_PORT, MBEDTLS_NET_PROTO_TCP );
    assert_exit(ret == 0, ret);
    mbedtls_ssl_set_bio( &ssl, &ctx, mbedtls_net_send, mbedtls_net_recv, NULL );

    mbedtls_printf(" ok\n  . Performing the SSL/TLS handshake ...");
    while ((ret = mbedtls_ssl_handshake(&ssl)) != 0)
    {
        if (ret != MBEDTLS_ERR_SSL_WANT_READ && ret != MBEDTLS_ERR_SSL_WANT_WRITE)
        {
            mbedtls_printf(" failed\n  ! mbedtls_ssl_handshake returned -0x%x\n\n", -ret);
            goto cleanup;
        }
    }

    mbedtls_printf(" ok\n  > Write to server:");
    ret = mbedtls_ssl_write(&ssl, (const uint8_t *)GET_REQUEST, strlen(GET_REQUEST));
    assert_exit(ret > 0, ret);

    len = ret;
    mbedtls_printf( " %d bytes written\n\n%s\n\n", len, GET_REQUEST);

    mbedtls_printf("  > Read from server:");
    len = sizeof(buf) - 1;
    memset(buf, 0x00, sizeof(buf));

    do {
        ret = mbedtls_ssl_read(&ssl, buf, len);
    } while (ret == MBEDTLS_ERR_SSL_WANT_READ ||
         ret == MBEDTLS_ERR_SSL_WANT_WRITE);
    assert_exit(ret > 0, ret);

    len = ret;
    mbedtls_printf( " %d bytes read\n\n\n%s\n\n", len, buf);
    
    mbedtls_ssl_close_notify(&ssl);
    mbedtls_printf(" ok\n  . Closing the connection ... done\n");

cleanup:
    mbedtls_net_free(&ctx);
    mbedtls_ssl_free(&ssl);
    mbedtls_ssl_config_free(&conf);
    mbedtls_ctr_drbg_free(&ctr_drbg);
    mbedtls_entropy_free(&entropy);
    mbedtls_x509_crt_free(&ca);

    return ret;
}
```

## src/ca_cert.h
```c
unsigned char ca_cert_der[] = {
    0X30, 0X82, 0X01, 0XB5, 0X30, 0X82, 0X01, 0X5A, 0XA0, 0X03, 0X02, 0X01,
    0X02, 0X02, 0X02, 0X3E, 0X8B, 0X30, 0X0C, 0X06, 0X08, 0X2A, 0X86, 0X48,
    0XCE, 0X3D, 0X04, 0X03, 0X02, 0X05, 0X00, 0X30, 0X39, 0X31, 0X18, 0X30,
    0X16, 0X06, 0X03, 0X55, 0X04, 0X03, 0X13, 0X0F, 0X69, 0X6F, 0X74, 0X77,
    0X75, 0X78, 0X69, 0X2D, 0X52, 0X6F, 0X6F, 0X74, 0X2D, 0X43, 0X41, 0X31,
    0X10, 0X30, 0X0E, 0X06, 0X03, 0X55, 0X04, 0X0A, 0X13, 0X07, 0X69, 0X6F,
    0X74, 0X77, 0X75, 0X78, 0X69, 0X31, 0X0B, 0X30, 0X09, 0X06, 0X03, 0X55,
    0X04, 0X06, 0X13, 0X02, 0X43, 0X4E, 0X30, 0X1E, 0X17, 0X0D, 0X31, 0X38,
    0X30, 0X31, 0X30, 0X31, 0X30, 0X30, 0X30, 0X30, 0X30, 0X30, 0X5A, 0X17,
    0X0D, 0X32, 0X33, 0X31, 0X32, 0X33, 0X31, 0X31, 0X31, 0X35, 0X39, 0X35,
    0X39, 0X5A, 0X30, 0X39, 0X31, 0X18, 0X30, 0X16, 0X06, 0X03, 0X55, 0X04,
    0X03, 0X13, 0X0F, 0X69, 0X6F, 0X74, 0X77, 0X75, 0X78, 0X69, 0X2D, 0X52,
    0X6F, 0X6F, 0X74, 0X2D, 0X43, 0X41, 0X31, 0X10, 0X30, 0X0E, 0X06, 0X03,
    0X55, 0X04, 0X0A, 0X13, 0X07, 0X69, 0X6F, 0X74, 0X77, 0X75, 0X78, 0X69,
    0X31, 0X0B, 0X30, 0X09, 0X06, 0X03, 0X55, 0X04, 0X06, 0X13, 0X02, 0X43,
    0X4E, 0X30, 0X59, 0X30, 0X13, 0X06, 0X07, 0X2A, 0X86, 0X48, 0XCE, 0X3D,
    0X02, 0X01, 0X06, 0X08, 0X2A, 0X86, 0X48, 0XCE, 0X3D, 0X03, 0X01, 0X07,
    0X03, 0X42, 0X00, 0X04, 0X05, 0X81, 0X0B, 0X6A, 0X9C, 0XD2, 0XE4, 0XCF,
    0XBB, 0X0B, 0X0F, 0X1B, 0X3B, 0X1E, 0X3F, 0XE5, 0X0C, 0X0E, 0X08, 0X44,
    0XE8, 0XBB, 0XDB, 0X91, 0XF1, 0X0B, 0XFA, 0X2B, 0XBD, 0XF9, 0X88, 0X48,
    0X49, 0X7E, 0X0E, 0X7C, 0X72, 0X65, 0XD3, 0X26, 0X78, 0XA4, 0XD5, 0X31,
    0XEF, 0X2A, 0X9C, 0XE4, 0X9F, 0X5D, 0X81, 0XC1, 0XA8, 0XAA, 0XDB, 0XE4,
    0XFF, 0X3B, 0X3E, 0X0B, 0X69, 0X2F, 0XEE, 0X53, 0XA3, 0X50, 0X30, 0X4E,
    0X30, 0X0C, 0X06, 0X03, 0X55, 0X1D, 0X13, 0X04, 0X05, 0X30, 0X03, 0X01,
    0X01, 0XFF, 0X30, 0X1D, 0X06, 0X03, 0X55, 0X1D, 0X0E, 0X04, 0X16, 0X04,
    0X14, 0XF6, 0X4E, 0X80, 0X7A, 0X16, 0X3E, 0XE6, 0XCA, 0X01, 0X2F, 0XE5,
    0X9B, 0XD7, 0X0B, 0X6F, 0X6E, 0X13, 0X56, 0X27, 0X5A, 0X30, 0X1F, 0X06,
    0X03, 0X55, 0X1D, 0X23, 0X04, 0X18, 0X30, 0X16, 0X80, 0X14, 0XF6, 0X4E,
    0X80, 0X7A, 0X16, 0X3E, 0XE6, 0XCA, 0X01, 0X2F, 0XE5, 0X9B, 0XD7, 0X0B,
    0X6F, 0X6E, 0X13, 0X56, 0X27, 0X5A, 0X30, 0X0C, 0X06, 0X08, 0X2A, 0X86,
    0X48, 0XCE, 0X3D, 0X04, 0X03, 0X02, 0X05, 0X00, 0X03, 0X47, 0X00, 0X30,
    0X44, 0X02, 0X20, 0X6F, 0X4F, 0XA9, 0X3B, 0XF8, 0X4D, 0XA7, 0X3F, 0X33,
    0X4E, 0XAB, 0XF5, 0X9C, 0X68, 0X95, 0X77, 0X22, 0XA1, 0X8B, 0XC7, 0X95,
    0XC9, 0X58, 0X62, 0X08, 0XB0, 0X56, 0X09, 0X9D, 0XC4, 0X4B, 0X8C, 0X02,
    0X20, 0X69, 0X1A, 0X7D, 0X2C, 0X36, 0XFB, 0X63, 0X37, 0X1B, 0X80, 0XCD,
    0X2B, 0X12, 0XB7, 0XBC, 0X4F, 0X4D, 0XC0, 0XA6, 0XF1, 0XB7, 0XE3, 0X22,
    0X0F, 0X9E, 0XB7, 0X5C, 0X49, 0XFA, 0XAF, 0X93, 0XD1
};
unsigned int ca_cert_der_len = 443;
```

## src/mbedtls_config.h
```c
#ifndef MBEDTLS_CONFIG_H
#define MBEDTLS_CONFIG_H

/* System support */
#define MBEDTLS_PLATFORM_C
#define MBEDTLS_PLATFORM_MEMORY
#define MBEDTLS_MEMORY_BUFFER_ALLOC_C
#define MBEDTLS_PLATFORM_NO_STD_FUNCTIONS
#define MBEDTLS_PLATFORM_EXIT_ALT
#define MBEDTLS_NO_PLATFORM_ENTROPY
#define MBEDTLS_NO_DEFAULT_ENTROPY_SOURCES
#define MBEDTLS_PLATFORM_PRINTF_ALT
#define MBEDTLS_PLATFORM_SNPRINTF_ALT

/* mbed TLS feature support */
#define MBEDTLS_ECP_DP_SECP256R1_ENABLED
#define MBEDTLS_KEY_EXCHANGE_ECDHE_ECDSA_ENABLED
#define MBEDTLS_SSL_PROTO_TLS1_2

/* mbed TLS modules */
#define MBEDTLS_AES_C
#define MBEDTLS_ASN1_PARSE_C
#define MBEDTLS_ASN1_WRITE_C
#define MBEDTLS_BIGNUM_C
#define MBEDTLS_CIPHER_C
#define MBEDTLS_CTR_DRBG_C
#define MBEDTLS_ECDH_C
#define MBEDTLS_ECDSA_C
#define MBEDTLS_ECP_C
#define MBEDTLS_ENTROPY_C
#define MBEDTLS_GCM_C
#define MBEDTLS_MD_C
#define MBEDTLS_OID_C
#define MBEDTLS_PK_C
#define MBEDTLS_PK_PARSE_C
#define MBEDTLS_SHA256_C
#define MBEDTLS_SHA512_C
#define MBEDTLS_SSL_CLI_C
#define MBEDTLS_SSL_SRV_C
#define MBEDTLS_SSL_TLS_C
#define MBEDTLS_X509_CRT_PARSE_C
#define MBEDTLS_X509_USE_C

/* Save RAM at the expense of ROM */
#define MBEDTLS_AES_ROM_TABLES

/* Save RAM by adjusting to our exact needs */
#define MBEDTLS_ECP_MAX_BITS   256
#define MBEDTLS_MPI_MAX_SIZE    32 // 256 bits is 32 bytes

/* Save RAM at the expense of speed, see ecp.h */
#define MBEDTLS_ECP_WINDOW_SIZE        2
#define MBEDTLS_ECP_FIXED_POINT_OPTIM  0

/* Significant speed benefit at the expense of some ROM */
#define MBEDTLS_ECP_NIST_OPTIM

/*
 * You should adjust this to the exact number of sources you're using: default
 * is the "mbedtls_platform_entropy_poll" source, but you may want to add other ones.
 * Minimum is 2 for the entropy test suite.
 */
#define MBEDTLS_ENTROPY_MAX_SOURCES 2

/* Save ROM and a few bytes of RAM by specifying our own ciphersuite list */
#define MBEDTLS_SSL_CIPHERSUITES MBEDTLS_TLS_ECDHE_ECDSA_WITH_AES_256_GCM_SHA384

/*
 * Save RAM at the expense of interoperability: do this only if you control
 * both ends of the connection!  (See coments in "mbedtls/ssl.h".)
 * The minimum size here depends on the certificate chain used as well as the
 * typical size of records.
 */
#define MBEDTLS_SSL_MAX_CONTENT_LEN             1024

#include "mbedtls/check_config.h"

#endif /* MBEDTLS_CONFIG_H */
```

## src/net_sockets.c
```c
#include <stdio.h>
#include <stdint.h>
#include <string.h>

#include <kernel.h>
#include <sys/fcntl.h>
#include <net/socket.h>
#include <net/net_app.h>

#include "mbedtls/platform.h"
#include "mbedtls/net_sockets.h"

#define read(fd,buf,len)        recv( fd, (char*)( buf ), (int)( len ), 0 )
#define write(fd,buf,len)       send( fd, (char*)( buf ), (int)( len ), 0 )

/*
 * Prepare for using the sockets interface
 */
static int net_prepare( void )
{
    return( 0 );
}

/*
 * Initialize a context
 */
void mbedtls_net_init( mbedtls_net_context *ctx )
{
    ctx->fd = -1;
}

/*
 * Initiate a TCP connection with host:port and the given protocol
 */
int mbedtls_net_connect( mbedtls_net_context *ctx, const char *host,
                         const char *port, int proto )
{
    int ret;
    struct addrinfo hints, *addr_list, *cur;

    if( ( ret = net_prepare() ) != 0 )
        return( ret );

    /* Do name resolution with both IPv6 and IPv4 */
    memset( &hints, 0, sizeof( hints ) );
    hints.ai_family = AF_UNSPEC;
    hints.ai_socktype = proto == MBEDTLS_NET_PROTO_UDP ? SOCK_DGRAM : SOCK_STREAM;
    hints.ai_protocol = proto == MBEDTLS_NET_PROTO_UDP ? IPPROTO_UDP : IPPROTO_TCP;

    if( getaddrinfo( host, port, &hints, &addr_list ) != 0 )
        return( MBEDTLS_ERR_NET_UNKNOWN_HOST );

    /* Try the sockaddrs until a connection succeeds */
    ret = MBEDTLS_ERR_NET_UNKNOWN_HOST;
    for( cur = addr_list; cur != NULL; cur = cur->ai_next )
    {
        ctx->fd = (int) socket( cur->ai_family, cur->ai_socktype,
                            cur->ai_protocol );
        if( ctx->fd < 0 )
        {
            ret = MBEDTLS_ERR_NET_SOCKET_FAILED;
            continue;
        }

        if( connect( ctx->fd, cur->ai_addr, cur->ai_addrlen ) == 0 )
        {
            ret = 0;
            break;
        }

        close( ctx->fd );
        ret = MBEDTLS_ERR_NET_CONNECT_FAILED;
    }

    freeaddrinfo( addr_list );

    return( ret );
}

/*
 * Check if the requested operation would be blocking on a non-blocking socket
 * and thus 'failed' with a negative return value.
 *
 * Note: on a blocking socket this function always returns 0!
 */
static int net_would_block( const mbedtls_net_context *ctx )
{
    int err = errno;

    /*
     * Never return 'WOULD BLOCK' on a non-blocking socket
     */
    if( ( fcntl( ctx->fd, F_GETFL, 0 ) & O_NONBLOCK ) != O_NONBLOCK )
    {
        errno = err;
        return( 0 );
    }

    switch( errno = err )
    {
#if defined EAGAIN
        case EAGAIN:
#endif
#if defined EWOULDBLOCK && EWOULDBLOCK != EAGAIN
        case EWOULDBLOCK:
#endif
            return( 1 );
    }
    return( 0 );
}

/*
 * Set the socket blocking or non-blocking
 */
int mbedtls_net_set_block( mbedtls_net_context *ctx )
{
    return( fcntl( ctx->fd, F_SETFL, fcntl( ctx->fd, F_GETFL, 0 ) & ~O_NONBLOCK ), 0 );
}

int mbedtls_net_set_nonblock( mbedtls_net_context *ctx )
{
    return( fcntl( ctx->fd, F_SETFL, fcntl( ctx->fd, F_GETFL, 0 ) | O_NONBLOCK ), 0 );
}

/*
 * Read at most 'len' characters
 */
int mbedtls_net_recv( void *ctx, unsigned char *buf, size_t len )
{
    int ret;
    int fd = ((mbedtls_net_context *) ctx)->fd;

    if( fd < 0 )
        return( MBEDTLS_ERR_NET_INVALID_CONTEXT );

    ret = (int) read( fd, buf, len );

    if( ret < 0 )
    {
        if( net_would_block( ctx ) != 0 )
            return( MBEDTLS_ERR_SSL_WANT_READ );

        if( errno == EPIPE || errno == ECONNRESET )
            return( MBEDTLS_ERR_NET_CONN_RESET );

        if( errno == EINTR )
            return( MBEDTLS_ERR_SSL_WANT_READ );

        return( MBEDTLS_ERR_NET_RECV_FAILED );
    }

    return( ret );
}

/*
 * Write at most 'len' characters
 */
int mbedtls_net_send( void *ctx, const unsigned char *buf, size_t len )
{
    int ret;
    int fd = ((mbedtls_net_context *) ctx)->fd;

    if( fd < 0 )
        return( MBEDTLS_ERR_NET_INVALID_CONTEXT );

    ret = (int) write( fd, buf, len );

    if( ret < 0 )
    {
        if( net_would_block( ctx ) != 0 )
            return( MBEDTLS_ERR_SSL_WANT_WRITE );

        if( errno == EPIPE || errno == ECONNRESET )
            return( MBEDTLS_ERR_NET_CONN_RESET );

        if( errno == EINTR )
            return( MBEDTLS_ERR_SSL_WANT_WRITE );

        return( MBEDTLS_ERR_NET_SEND_FAILED );
    }

    return( ret );
}

/*
 * Gracefully close the connection
 */
void mbedtls_net_free( mbedtls_net_context *ctx )
{
    if( ctx->fd == -1 )
        return;

#if 0
    shutdown( ctx->fd, 2 );
#endif

    close( ctx->fd );
    ctx->fd = -1;
}

/*
 * Portable usleep helper
 */
void mbedtls_net_usleep( unsigned long usec )
{
    return;
}

/*
 * Create a listening socket on bind_ip:port
 */
int mbedtls_net_bind( mbedtls_net_context *ctx, const char *bind_ip, const char *port, int proto )
{
    return 0;
}

/*
 * Accept a connection from a remote client
 */
int mbedtls_net_accept( mbedtls_net_context *bind_ctx,
                        mbedtls_net_context *client_ctx,
                        void *client_ip, size_t buf_size, size_t *ip_len )
{
    return( 0 );
}

/*
 * Check if data is available on the socket
 */
int mbedtls_net_poll( mbedtls_net_context *ctx, uint32_t rw, uint32_t timeout )
{
    return( 0 );
}

/*
 * Read at most 'len' characters, blocking for at most 'timeout' ms
 */
int mbedtls_net_recv_timeout( void *ctx, unsigned char *buf,
                              size_t len, uint32_t timeout )
{
    return 0;
}
```
