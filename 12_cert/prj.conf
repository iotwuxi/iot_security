## prj.conf
```kconfig
CONFIG_STDOUT_CONSOLE=y
CONFIG_ENTROPY_GENERATOR=y

CONFIG_MBEDTLS=y
CONFIG_MBEDTLS_BUILTIN=y
CONFIG_MBEDTLS_ENABLE_HEAP=y
CONFIG_MBEDTLS_HEAP_SIZE=10240
CONFIG_MBEDTLS_CFG_FILE="mbedtls_config.h"

CONFIG_MAIN_STACK_SIZE=4096
```

## src/main.c
```c
#include <zephyr.h>

#include <stdio.h>
#include <string.h>

#include "mbedtls/x509_crt.h"
#include "mbedtls/platform.h"

#include "certs.h"

#define assert_exit(cond, ret) \
    do { if (!(cond)) { \
        printf("  !. assert: failed [line: %d, error: -0x%04X]\n", __LINE__, -ret); \
        goto cleanup; \
    } } while (0)

static int my_verify(void *data, mbedtls_x509_crt *crt, 
                                int depth, uint32_t *flags)
{
    ((void) data);
    char buf[1024];
    int ret = mbedtls_x509_crt_info(buf, sizeof(buf) - 1, "      ", crt);
    mbedtls_printf("  . Verify requested for (Depth %d) ... ok\n", depth);
    for(uint32_t i = 0; i < ret; i++) {
        mbedtls_printf("%c", buf[i]);
    }

    if ((*flags) != 0) {
        ret = mbedtls_x509_crt_verify_info(buf, sizeof(buf), "  ! ", *flags);
        for(uint32_t i = 0; i < ret; i++) {
            mbedtls_printf("%c", buf[i]);
        }
    }
    mbedtls_printf("\n");

    return(0);
}

int main(void)
{
    int ret = 0; 
    uint32_t flags = 0;
    mbedtls_x509_crt cert, cacert;

    mbedtls_platform_set_printf(printf);
    mbedtls_platform_set_snprintf(snprintf);

    mbedtls_x509_crt_init(&cert); 
    mbedtls_x509_crt_init(&cacert);

    ret = mbedtls_x509_crt_parse(&cert, bob_cert, sizeof(bob_cert));
    assert_exit(ret == 0, ret);
    ret = mbedtls_x509_crt_parse(&cacert, ca_cert, sizeof(ca_cert));
    assert_exit(ret == 0, ret);
    mbedtls_printf("\n  . Loading the certificate(s) ... ok\n\n");

    ret = mbedtls_x509_crt_verify(&cert, &cacert, NULL, NULL, &flags, my_verify, NULL);
    assert_exit(ret == 0, ret);

cleanup:
    mbedtls_x509_crt_free(&cert); 
    mbedtls_x509_crt_free(&cacert);

    return(ret != 0);
}
```

## src/certs.h
```c
#ifndef __CERTS_H__
#define __CERTS_H__

const char ca_cert[] =
"-----BEGIN CERTIFICATE-----\r\n"
"MIIBozCCAUegAwIBAgIBATAMBggqhkjOPQQDAgUAMDAxCzAJBgNVBAMTAkNBMREw\r\n"
"DwYDVQQKEwhzZWN1cml0eTEOMAwGA1UEBhMFY2hpbmEwHhcNMTgwMTAxMDAwMDAw\r\n"
"WhcNMjIwMTAxMDAwMDAwWjAwMQswCQYDVQQDEwJDQTERMA8GA1UEChMIc2VjdXJp\r\n"
"dHkxDjAMBgNVBAYTBWNoaW5hMFkwEwYHKoZIzj0CAQYIKoZIzj0DAQcDQgAE81rj\r\n"
"va1bE5pxBCgXppUHJNFc2K+lW7BzATgJMQ35Xn+jfWmYjeKL/TVCsZ/BMq8cKet/\r\n"
"xNrYI3Kjt1/pUOad76NQME4wDAYDVR0TBAUwAwEB/zAdBgNVHQ4EFgQUe18dVKQx\r\n"
"VPnwYtFmGfezOWZpmh4wHwYDVR0jBBgwFoAUe18dVKQxVPnwYtFmGfezOWZpmh4w\r\n"
"DAYIKoZIzj0EAwIFAANIADBFAiB94exApxOjGlXcv3c43Jzy1bHagUyT6DLvvGBm\r\n"
"rH+9xAIhANLtH5XjLJemGYJyhhg/Zo9HHRJxD2CYPFmK09JoR/Ph\r\n"
"-----END CERTIFICATE-----\r\n";

const char bob_cert[] =
"-----BEGIN CERTIFICATE-----\r\n"
"MIIBojCCAUWgAwIBAgIBATAMBggqhkjOPQQDAgUAMDAxCzAJBgNVBAMTAkNBMREw\r\n"
"DwYDVQQKEwhzZWN1cml0eTEOMAwGA1UEBhMFY2hpbmEwHhcNMTgwMTAxMDAwMDAw\r\n"
"WhcNMjIwMTAxMDAwMDAwWjAxMQwwCgYDVQQDEwNCb2IxETAPBgNVBAoTCHNlY3Vy\r\n"
"aXR5MQ4wDAYDVQQGEwVjaGluYTBZMBMGByqGSM49AgEGCCqGSM49AwEHA0IABHnD\r\n"
"gZUEliDO7Rh9i9ehyr0UYxv0VQXt9F2kMh/c87FSztHeAy/GRBHyIhhMzZ25c+1j\r\n"
"pQSiRADIYC+hSQnCSvOjTTBLMAkGA1UdEwQCMAAwHQYDVR0OBBYEFLfb53i60Leg\r\n"
"/kgAYG9pf57UA60fMB8GA1UdIwQYMBaAFHtfHVSkMVT58GLRZhn3szlmaZoeMAwG\r\n"
"CCqGSM49BAMCBQADSQAwRgIhAMkQ0gvFdziJsAaKT/L33m8cdrXhhEe3tNCPlgS2\r\n"
"N3HtAiEAxNfZa5sWfe9bdf37PgkhHAC3oWnriSpSFqzrQ3Yhc0g=\r\n"
"-----END CERTIFICATE-----\r\n";

#endif
```

## src/mbedtls_config.h
```c
#ifndef MBEDTLS_CONFIG_H
#define MBEDTLS_CONFIG_H

/* System support */
#define MBEDTLS_PLATFORM_C
#define MBEDTLS_PLATFORM_MEMORY
#define MBEDTLS_MEMORY_BUFFER_ALLOC_C
#define MBEDTLS_PLATFORM_NO_STD_FUNCTIONS
#define MBEDTLS_PLATFORM_EXIT_ALT
#define MBEDTLS_NO_PLATFORM_ENTROPY
#define MBEDTLS_NO_DEFAULT_ENTROPY_SOURCES
#define MBEDTLS_PLATFORM_PRINTF_ALT
#define MBEDTLS_PLATFORM_SNPRINTF_ALT

/* mbed TLS modules */
#define MBEDTLS_MD_C
#define MBEDTLS_SHA256_C
#define MBEDTLS_PK_C
#define MBEDTLS_PK_PARSE_C

#define MBEDTLS_ECP_C
#define MBEDTLS_ASN1_PARSE_C
#define MBEDTLS_ASN1_WRITE_C
#define MBEDTLS_ECDSA_C
#define MBEDTLS_ECP_DP_SECP256R1_ENABLED

#define MBEDTLS_OID_C
#define MBEDTLS_BIGNUM_C
#define MBEDTLS_BASE64_C
#define MBEDTLS_PEM_PARSE_C
#define MBEDTLS_X509_USE_C
#define MBEDTLS_X509_CRT_PARSE_C

#include "mbedtls/check_config.h"

#endif /* MBEDTLS_CONFIG_H */
```
