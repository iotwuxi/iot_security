## prj.conf
```kconfig
CONFIG_STDOUT_CONSOLE=y

CONFIG_MBEDTLS=y
CONFIG_MBEDTLS_BUILTIN=y
CONFIG_MBEDTLS_CFG_FILE="mbedtls_config.h"
```

## src/main.c
```c
/*
 * @file
 * @brief chapter start samples.
 * @note  测试向量来自 https://tools.ietf.org/html/rfc3548
*/
#include <zephyr.h>

#include <stdio.h>
#include <string.h>
#include <stdint.h>

#include "mbedtls/base64.h"
#include "mbedtls/platform.h"

static uint8_t msg[] = 
{
    0x14, 0xfb, 0x9c, 0x03, 0xd9, 0x7e
};

void dump_buf(char *info, uint8_t *buf, uint32_t len)
{
    mbedtls_printf("%s", info);
    for(uint32_t i = 0; i < len; i++) {
        mbedtls_printf("%02x ", msg[i]);
    }
    mbedtls_printf("\n");
}

int main(void)
{
    size_t len;
    uint8_t rst[512];

    mbedtls_platform_set_printf(printf);

    len = sizeof(msg);
    dump_buf("\n  base64 message: ", msg, len);

    mbedtls_base64_encode(rst, sizeof(rst), &len, msg, len);
    mbedtls_printf("  base64 encode : %s\n", rst);

    mbedtls_base64_decode(rst, sizeof(rst), &len, rst, len);
    dump_buf("  base64 decode : ", rst, len);
    printf("\n");

    return 0;
}
```

## src/mbedtls_config.h
```c
#ifndef MBEDTLS_CONFIG_H
#define MBEDTLS_CONFIG_H

/* System support */
#define MBEDTLS_PLATFORM_C
#define MBEDTLS_PLATFORM_MEMORY
#define MBEDTLS_MEMORY_BUFFER_ALLOC_C
#define MBEDTLS_PLATFORM_NO_STD_FUNCTIONS
#define MBEDTLS_PLATFORM_EXIT_ALT
#define MBEDTLS_NO_PLATFORM_ENTROPY
#define MBEDTLS_NO_DEFAULT_ENTROPY_SOURCES
#define MBEDTLS_PLATFORM_PRINTF_ALT

/* mbed TLS modules */
#define MBEDTLS_BASE64_C

#include "mbedtls/check_config.h"

#endif /* MBEDTLS_CONFIG_H */
```
